# AM335x register map
Vendor: Texas Instruments; Series: Sitara AM335x; File version: 1.1
AM335x EMIF4D and DDR PHY generated from EMIF.hpp
CPU: Cortex-A8 r0p0, little endian
Registers are 32-bit, read-write, reset 0x0 unless marked. A register's access mark holds for its fields unless they carry their own. Offsets are from the block's base; lines under a group give offsets from that group; [hi:lo] are bit positions; {n}, {i} and the like mark numbered series; 'fields as' and 'values as' point back to an identical list; <NAME> marks a mode.

## Memory map
0x44E00000 CM_PER — Clock Module - Peripheral
0x44E00400 CM_WKUP — Clock Module - Wakeup
0x44E00500 CM_DPLL — Clock Module - DPLL
0x44E00600 CM_MPU — Clock Module - MPU
0x44E00700 CM_DEVICE — Clock Module - Device
0x44E00800 CM_RTC — Clock Module - RTC
0x44E00900 CM_GFX — Clock Module - GFX
0x44E00A00 CM_CEFUSE — Clock Module - CEFUSE
0x44E00B00 PRM_IRQ — Power Reset Module - IRQ
0x44E00C00 PRM_PER — Power Reset Module - Peripheral
0x44E00D00 PRM_WKUP — Power Reset Module - Wakeup
0x44E00E00 PRM_MPU — Power Reset Module - MPU
0x44E00F00 PRM_DEVICE — Power Reset Module - Device
0x44E01000 PRM_RTC — Power Reset Module - RTC
0x44E01100 PRM_GFX — Power Reset Module - GFX
0x44E01200 PRM_CEFUSE — Power Reset Module - CEFUSE
0x44E09000 UART — UART0 module
0x44E12000 DDR23mPHY — DDR PHY Control Registers
0x4C000000 EMIF0 — External Memory Interface 4D (EMIF) - DDR Controller

## DDR23mPHY — DDR PHY Control Registers
Base 0x44E12000
{0x1C+0x34*i} CMD{i}_CTRL_SLAVE_RATIO_0 (i=0..2) — CSR0 Register
  [9:0] CMD_SLAVE_RATIO wo — Ratio value for address/command launch timing in DDR PHY macro. This is the fraction of a
{0x28+0x34*i} CMD{i}_DLL_LOCK_DIFF_0 (i=0..2) — DLD0 Register
  [3:0] DLL_LOCK_DIFF wo — The max number of delay line taps variation allowed while maintaining the master DLL lock.This is
{0x2C+0x34*i} CMD{i}_INVERT_CLKOUT_0 (i=0..2) — ICLK0 Register
  [0] INVERT_CLK_SEL — bit: 0 (W) Inverts the polarity of DRAM clock.
0xC8 DATA0_RD_DQS_SLAVE_RATIO_0 — RDQSSR0 Register
  [9:0] RD_DQS_SLAVE_RATIO_CS0 wo — Ratio value for Read DQS slave DLL for CS0.
0xDC DATA0_WR_DQS_SLAVE_RATIO_0 — WDQSSR0 Register
  [9:0] WR_DQS_SLAVE_RATIO_CS0 wo — Ratio value for Write DQS slave DLL for CS0.
0xF0 DATA0_WRLVL_INIT_RATIO_0 — MWRLVLINI_RATIO Register
  [9:0] WRLVL_INIT_RATIO_CS0 wo — The user programmable init ratio used by Write Leveling FSM when
0xF8 DATA0_WRLVL_INIT_MODE_0 — MWRLVLINI_MODE Register
  [0] WRLVL_INIT_MODE_SEL — bit: 0 (W) The user programmable init ratio selection mode for Write Leveling FSM.
0xFC DATA0_GATELVL_INIT_RATIO_0 — DQSGTI_RATIO Register
  [9:0] GATELVL_INIT_RATIO_CS0 wo — The user programmable init ratio used by DQS Gate Training FSM when
0x104 DATA0_GATELVL_INIT_MODE_0 — DQS_GTI_MODE Register
  [0] GATELVL_INIT_MODE_SEL — bit: 0 (W) User programmable init ratio selection mode for DQS Gate Training FSM.
0x108 DATA0_FIFO_WE_SLAVE_RATIO_0 — DQS_GS_RATIO Register
  [9:0] FIFO_WE_SLAVE_RATIO_CS0 wo — Ratio value for fifo we for CS0.
0x11C DATA0_DQ_OFFSET_0 — DQS_T_DQ_OFFSET Register
  [6:0] OFFSET — Default value 40 equates to a 90 degree shift.
0x120 DATA0_WR_DATA_SLAVE_RATIO_0 — WDS_RATIO Register
  [9:0] WR_DATA_SLAVE_RATIO_CS0 wo — Ratio value for write data slave DLL for CS0.
0x134 DATA0_USE_RANK0_DELAYS — DELAY_SEL Register
  [0] RANK0_DELAY — bit: 0 (W) Delay Selection
0x138 DATA0_DLL_LOCK_DIFF_0 — DLL_LOCK_DIFF Register
  fields as CMD0_DLL_LOCK_DIFF_0
0x16C DATA1_RD_DQS_SLAVE_RATIO_0 — RDQSSR0 Register
  fields as DATA0_RD_DQS_SLAVE_RATIO_0
0x180 DATA1_WR_DQS_SLAVE_RATIO_0 — WDQSSR0 Register
  fields as DATA0_WR_DQS_SLAVE_RATIO_0
0x194 DATA1_WRLVL_INIT_RATIO_0 — MWRLVLINI_RATIO Register
  fields as DATA0_WRLVL_INIT_RATIO_0
0x19C DATA1_WRLVL_INIT_MODE_0 — MWRLVLINI_MODE Register
  fields as DATA0_WRLVL_INIT_MODE_0
0x1A0 DATA1_GATELVL_INIT_RATIO_0 — DQSGTI_RATIO Register
  fields as DATA0_GATELVL_INIT_RATIO_0
0x1A8 DATA1_GATELVL_INIT_MODE_0 — DQS_GTI_MODE Register
  fields as DATA0_GATELVL_INIT_MODE_0
0x1AC DATA1_FIFO_WE_SLAVE_RATIO_0 — DQS_GS_RATIO Register
  [9:0] FIFO_WE_SLAVE_RATIO_CS0 wo — Ratio value for fifo we for CS0.
0x1C0 DATA1_DQ_OFFSET_0 — DQS_T_DQ_OFFSET Register
  [6:0] OFFSET — Default value 40 equates to a 90 degree shift.
0x1C4 DATA1_WR_DATA_SLAVE_RATIO_0 — WDS_RATIO Register
  fields as DATA0_WR_DATA_SLAVE_RATIO_0
0x1D8 DATA1_USE_RANK0_DELAYS — DELAY_SEL Register
  [0] RANK0_DELAY — bit: 0 (W) Delay Selection
0x1DC DATA1_DLL_LOCK_DIFF_0 — DLL_LOCK_DIFF Register
  fields as CMD0_DLL_LOCK_DIFF_0
