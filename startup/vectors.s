@******************************************************************************
@
@ vectors.s - Exception vectors and minimal handlers for ARM Cortex-A8
@             Compatible with AM335x (GP devices) and other ARM cores
@
@******************************************************************************

@****************************** Global Symbols *******************************
        .global _vectors
        .global _vector_end
        .global UndefInstHandler
        .global SVC_Handler
        .global PrefetchAbortHandler
        .global DataAbortHandler
        .global IRQHandler
        .global FIQHandler              @ Сохраняем для совместимости

@ Внешние символы из boot.s и других файлов
        .global Entry                   @ Reset handler из boot.s

@****************************** Exception Handlers ***************************
@
@ Минимальные обработчики исключений.
@ Все обработчики делают одно и то же - бесконечный цикл с WFI.
@ Для отладки можно заменить на bkpt или вызов отладочных функций.
@

.section .text.handlers, "ax"
.code 32

@-----------------------------------------------------------------------------
@ Обработчик Undefined Instruction
@-----------------------------------------------------------------------------
UndefInstHandler:
        @ Сохраняем LR (адрес возврата) для отладки
        @ Здесь можно сохранить в глобальную переменную, но для минимального
        @ обработчика просто зависаем
        bkpt #0
        b     InfiniteLoop

@-----------------------------------------------------------------------------
@ Обработчик Software Interrupt (SVC)
@-----------------------------------------------------------------------------
SVC_Handler:
        @ Можно получить номер SVC из инструкции:
        @ LDR   r0, [lr, #-4]
        @ AND   r0, r0, #0x00FFFFFF   @ r0 = номер SVC

        @ Минимальная обработка - просто возврат
        @ Для совместимости с C++ конструкторами (__libc_init_array)
        @ который может использовать SVC, делаем простой возврат
        bkpt #0
        movs  pc, lr                   @ Возврат из SVC (восстанавливает CPSR)

@-----------------------------------------------------------------------------
@ Обработчик Prefetch Abort
@-----------------------------------------------------------------------------
PrefetchAbortHandler:
        @ Адрес ошибки можно получить из регистра FAR (CP15 c6)
        @ MRC   p15, 0, r0, c6, c0, 0  @ r0 = fault address

        @ Минимальная обработка - зависаем
        bkpt #0
        b     InfiniteLoop

@-----------------------------------------------------------------------------
@ Обработчик Data Abort
@-----------------------------------------------------------------------------
DataAbortHandler:
        @ Адрес ошибки в FAR (CP15 c6)
        @ MRC   p15, 0, r0, c6, c0, 0  @ r0 = fault address

        @ Минимальная обработка - зависаем
        bkpt #0
        b     InfiniteLoop

@-----------------------------------------------------------------------------
@ Обработчик IRQ (все обычные прерывания)
@-----------------------------------------------------------------------------
IRQHandler:
        @ Сохраняем контекст (минимально - только LR и SPSR)
        @ На AM335x здесь нужно читать GIC регистры
        @ Для простого проекта - просто возвращаемся

        @ Сохраняем LR_irq в стек (он будет изменен при вызове функций)
        SUB   lr, lr, #4               @ Корректируем LR для возврата
        SRSDB sp!, #0x12               @ Сохраняем LR и SPSR в стек IRQ режима

        @ Здесь будет обработка прерываний
        @ Для начала - просто ничего не делаем

        @ Восстанавливаем контекст и возвращаемся
        bkpt #0
        RFEIA sp!                      @ Восстанавливаем PC и CPSR из стека

@-----------------------------------------------------------------------------
@ Обработчик FIQ (быстрое прерывание)
@-----------------------------------------------------------------------------
FIQHandler:
        @ FIQ имеет отдельный банк регистров (r8-r12, sp_fiq, lr_fiq)
        @ Даже если на конкретном процессоре FIQ недоступен,
        @ этот обработчик будет работать корректно

        @ FIQ должен быть максимально быстрым
        @ Минимальный обработчик - просто возврат
        subs  pc, lr, #4               @ Возврат с коррекцией LR (быстрее чем 2 инструкции)

@-----------------------------------------------------------------------------
@ Бесконечный цикл с WFI (Wait For Interrupt)
@-----------------------------------------------------------------------------
InfiniteLoop:
        WFI                           @ Ждем прерывание (снижаем энергопотребление)
        B     InfiniteLoop             @ Бесконечный цикл

@****************************** Vector Table **********************************
@
@ Таблица векторов должна быть выровнена на 32 байта и расположена в начале
@ памяти или по адресу, указанному в VBAR.
@

    .section .vectors, "ax"
    .code 32
    .align 5                            @ Выравнивание на 32 байта (2^5)

_vectors:
        @ 0x00: Reset
        ldr   pc, =Entry

        @ 0x04: Undefined Instruction
        ldr   pc, =UndefInstHandler

        @ 0x08: Software Interrupt (SVC)
        ldr   pc, =SVC_Handler

        @ 0x0C: Prefetch Abort
        ldr   pc, =PrefetchAbortHandler

        @ 0x10: Data Abort
        ldr   pc, =DataAbortHandler

        @ 0x14: Reserved
        nop

        @ 0x18: IRQ
        ldr   pc, =IRQHandler

        @ 0x1C: FIQ
        ldr   pc, =FIQHandler

_vector_end:

@****************************** End of file ***********************************
        .end